## build/conf/bblayers.conf
```bitbake
# POKY_BBLAYERS_CONF_VERSION is increased each time build/conf/bblayers.conf
# changes incompatibly
POKY_BBLAYERS_CONF_VERSION = "2"

BBPATH = "${TOPDIR}"
BBFILES ?= ""

BBLAYERS ?= " \
  /workspace/poky-dunfell/meta \
  /workspace/poky-dunfell/meta-poky \
  /workspace/poky-dunfell/meta-yocto-bsp \
  /workspace/meta-tegra \  
"
```
